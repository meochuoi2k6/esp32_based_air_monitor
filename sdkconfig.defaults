## sdkconfig.defaults
```kconfig
# IRAM Optimizations
CONFIG_FREERTOS_PLACE_FUNCTIONS_INTO_FLASH=y
CONFIG_RINGBUF_PLACE_FUNCTIONS_INTO_FLASH=y
CONFIG_RINGBUF_PLACE_ISR_FUNCTIONS_INTO_FLASH=y
CONFIG_ESP_WIFI_IRAM_OPT=n
CONFIG_ESP_WIFI_RX_IRAM_OPT=n
CONFIG_BT_NIMBLE_PINNED_TO_CORE_0=y
CONFIG_SPI_FLASH_ROM_IMPL=y

# Partition Table
CONFIG_PARTITION_TABLE_CUSTOM=y
CONFIG_PARTITION_TABLE_CUSTOM_FILENAME="partitions.csv"
CONFIG_PARTITION_TABLE_FILENAME="partitions.csv"

# Bluetooth Configs
CONFIG_BT_ENABLED=y
CONFIG_BT_BLUEDROID_ENABLED=y
CONFIG_BT_CONTROLLER_ENABLED=y
CONFIG_BT_BLE_ENABLED=y
CONFIG_BT_GATTS_ENABLE=y
CONFIG_BT_GATTC_ENABLE=y
CONFIG_BTDM_CTRL_MODE_BLE_ONLY=y
CONFIG_BT_SMP_ENABLE=y

# Display / SSD1306
CONFIG_I2C_INTERFACE=y
CONFIG_SSD1306_128x64=y
CONFIG_SCL_GPIO=22
CONFIG_SDA_GPIO=21
CONFIG_RESET_GPIO=15
CONFIG_I2C_PORT_0=y

# Flash Config
CONFIG_ESPTOOLPY_FLASHMODE_DIO=y
CONFIG_ESPTOOLPY_FLASHFREQ_40M=y
CONFIG_ESPTOOLPY_FLASHSIZE_4MB=y
```
